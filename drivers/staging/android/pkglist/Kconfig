## drivers/staging/android/pkglist/Kconfig
```kconfig
config PKGLIST
	tristate "Package list for emulated 'SD card' file system for Android"
	default ANDROID
	help
	  Pkglist is a means for the kernel to access the information presented in the
	  Android Userspace as packages.list
choice
	prompt "Configuration options"
	depends on PKGLIST
	help
	  Configuration options. This controls how you provide the emulated
	  SD card layer with configuration information from userspace.

config PKGLIST_USE_CONFIGFS
	bool "Use Configfs based pkglist"
	depends on CONFIGFS_FS
	help
	  Use configfs based pkglist driver for configuration information.

config PKGLIST_NO_CONFIG
	bool "None"
	help
	  This does not allow configuration of sdcardfs.
endchoice
```

## fs/crypto/Kconfig
```kconfig
config FS_ENCRYPTION
	tristate "FS Encryption (Per-file encryption)"
	select CRYPTO
	select CRYPTO_AES
	select CRYPTO_CBC
	select CRYPTO_ECB
	select CRYPTO_XTS
	select CRYPTO_CTS
	select CRYPTO_CTR
	select CRYPTO_SHA256
	select KEYS
	help
	  Enable encryption of files and directories.  This
	  feature is similar to ecryptfs, but it is more memory
	  efficient since it avoids caching the encrypted and
	  decrypted pages in the page cache.

config FS_ENCRYPTION_HW_CRYPT
	tristate "Enable fscrypt to use inline crypto"
	default n
	depends on FS_ENCRYPTION && BLK_CRYPT_CTX
	help
	  Enables fscrypt to use inline crypto hardware if available.
```

## lib/Kconfig.ubsan
```kconfig
# SPDX-License-Identifier: GPL-2.0-only
config ARCH_HAS_UBSAN_SANITIZE_ALL
	bool

menuconfig UBSAN
	bool "Undefined behaviour sanity checker"
	help
	  This option enables undefined behaviour sanity checker
	  Compile-time instrumentation is used to detect various undefined
	  behaviours in runtime. Various types of checks may be enabled
	  via boot parameter ubsan_handle
	  (see: Documentation/dev-tools/ubsan.rst).

if UBSAN

config UBSAN_SANITIZE_ALL
	bool "Enable UBSAN instrumentation for the entire kernel"
	depends on ARCH_HAS_UBSAN_SANITIZE_ALL

	# We build with -Wno-maybe-uninitilzed, but we still want to
	# use -Wmaybe-uninitilized in allmodconfig builds.
	# The dependency below is used to disable this option in allmodconfig
	depends on !COMPILE_TEST
	default y
	help
	  This option activates instrumentation for the entire kernel.
	  If you don't enable this option, you have to explicitly specify
	  UBSAN_SANITIZE := y for the files/directories you want to check for UB.
	  Enabling this option will get kernel image size increased
	  significantly.

config UBSAN_ALIGNMENT
	bool "Enable checking of pointer alignment (-fsanitize=alignment)"
	depends on !COMPILE_TEST # Disable for allmodconfig
	default !HAVE_EFFICIENT_UNALIGNED_ACCESS
	help
	  This option enables the check of unaligned memory accesses.
	  Enabling this option on architectures that support unaligned
	  accesses may produce a lot of false positives.

config TEST_UBSAN
	tristate "Module for testing for undefined behavior detection"
	depends on m
	help
	  This is a test module for UBSAN.
	  It triggers various undefined behavior, and detect it.

config UBSAN_BOUNDS
	bool "Perform array index bounds checking"
	default UBSAN
	help
	  This option enables detection of directly indexed out of bounds
	  array accesses, where the array size is known at compile time.
	  Note that this does not protect array overflows via bad calls
	  to the {str,mem}*cpy() family of functions (that is addressed
	  by CONFIG_FORTIFY_SOURCE).

config UBSAN_BOUNDS_ENFORCE
	bool "Trap on detected out of bounds access"
	depends on UBSAN_BOUNDS
	help
	  Building kernels with UBSAN features enabled tends to grow
	  the kernel size by over 5%, due to adding all the debugging
	  text on failure paths. To avoid this, Sanitizer instrumentation
	  can just issue a trap. This reduces the kernel size overhead but
	  turns all warnings into full thread-killing exceptions. This
	  option switches bounds sanitizer to the trap mode.

config UBSAN_MISC
	bool "Enable all other Undefined Behavior sanity checks"
	default UBSAN
	help
	  This option enables all sanity checks that don't have their
	  own config options. Disable it if you only want to have
	  individually selected checks.

endif
```

## lib/vdso/Kconfig
```kconfig
# SPDX-License-Identifier: GPL-2.0

config HAVE_GENERIC_VDSO
	bool
	default n

if HAVE_GENERIC_VDSO

config GENERIC_GETTIMEOFDAY
	bool
	help
	  This is a generic implementation of gettimeofday vdso.
	  Each architecture that enables this feature has to
	  provide the fallback implementation.

config GENERIC_VDSO_32
	bool
	depends on GENERIC_GETTIMEOFDAY && !64BIT
	help
	  This config option helps to avoid possible performance issues
	  in 32 bit only architectures.

config HAVE_HW_COUNTER
	bool
	depends on GENERIC_GETTIMEOFDAY
	help
	  Select this configuration option if the architecture has an arch
	  timer.

config GENERIC_COMPAT_VDSO
	bool
	help
	  This config option enables the compat VDSO layer.

config CROSS_COMPILE_COMPAT_VDSO
	string "32 bit Toolchain prefix for compat vDSO"
	depends on GENERIC_COMPAT_VDSO
	help
	  Defines the cross-compiler prefix for compiling compat vDSO.

endif
```
